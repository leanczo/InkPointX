#include "Pdf.h"

#include <CacheIntegrity.h>
#include <Logging.h>

#include <algorithm>
#include <cctype>
#include <cmath>
#include <cstring>
#include <limits>
#include <new>

#include "PdfRasterizer.h"
#include "PdfRuntime.h"

namespace {
// Bump whenever the on-device package builder changes so incomplete/older
// caches are regenerated by the current parser.
// v11 invalidates packages produced by the short-lived strict Image-XObject
// check.  That check rejected an otherwise renderable vector page as soon as
// it encountered even a small bitmap (for example, the Free-scores.com logo),
// leaving a durable "unsupported content" page in the cache.
constexpr uint8_t PACKAGE_VERSION = 11;
constexpr size_t MAX_PAGES = 4096;
constexpr size_t MAX_CMAP_ENTRIES = 256;
constexpr size_t MAX_PAGE_CMAP_ENTRIES = 384;
constexpr size_t PDF_TOKEN_SIZE = 1024;
constexpr char METADATA_FILE[] = "/pdf_metadata.txt";
constexpr char PACKAGE_STATE_FILE[] = "/pdf_package.bin";
constexpr char IMAGE_RECORDS_FILE[] = "/.pdf_images.bin";

void writeBytes(HalFile& file, const char* data, size_t length) {
  pdf_runtime::serviceWatchdog();
  if (length > 0) file.write(data, length);
}

void writeBytes(HalFile& file, const std::string& value) { writeBytes(file, value.data(), value.size()); }

void writeBytes(HalFile& file, const char* value) { writeBytes(file, value, strlen(value)); }

void appendUtf8(std::string& output, uint32_t codepoint) {
  if (codepoint == 0 || codepoint > 0x10ffff || (codepoint >= 0xd800 && codepoint <= 0xdfff)) return;
  if (codepoint < 0x80) {
    if (codepoint >= 0x20 || codepoint == '\n' || codepoint == '\t') output.push_back(static_cast<char>(codepoint));
  } else if (codepoint < 0x800) {
    output.push_back(static_cast<char>(0xc0 | (codepoint >> 6)));
    output.push_back(static_cast<char>(0x80 | (codepoint & 0x3f)));
  } else if (codepoint < 0x10000) {
    output.push_back(static_cast<char>(0xe0 | (codepoint >> 12)));
    output.push_back(static_cast<char>(0x80 | ((codepoint >> 6) & 0x3f)));
    output.push_back(static_cast<char>(0x80 | (codepoint & 0x3f)));
  } else {
    output.push_back(static_cast<char>(0xf0 | (codepoint >> 18)));
    output.push_back(static_cast<char>(0x80 | ((codepoint >> 12) & 0x3f)));
    output.push_back(static_cast<char>(0x80 | ((codepoint >> 6) & 0x3f)));
    output.push_back(static_cast<char>(0x80 | (codepoint & 0x3f)));
  }
}

void writeXmlEscaped(HalFile& file, const char* text, size_t length, bool attribute = false) {
  size_t start = 0;
  for (size_t i = 0; i < length; ++i) {
    const unsigned char value = static_cast<unsigned char>(text[i]);
    const char* replacement = nullptr;
    if (value < 0x20 && value != '\n' && value != '\r' && value != '\t') {
      writeBytes(file, text + start, i - start);
      start = i + 1;
      continue;
    }
    switch (text[i]) {
      case '&':
        replacement = "&amp;";
        break;
      case '<':
        replacement = "&lt;";
        break;
      case '>':
        replacement = "&gt;";
        break;
      case '"':
        if (attribute) replacement = "&quot;";
        break;
      case '\'':
        if (attribute) replacement = "&apos;";
        break;
      default:
        break;
    }
    if (!replacement) continue;
    writeBytes(file, text + start, i - start);
    writeBytes(file, replacement);
    start = i + 1;
  }
  writeBytes(file, text + start, length - start);
}

void writeXmlEscaped(HalFile& file, const std::string& value, bool attribute = false) {
  writeXmlEscaped(file, value.data(), value.size(), attribute);
}

bool writeStaticFile(const std::string& path, const char* contents) {
  HalFile file;
  if (!Storage.openFileForWrite("PDF", path, file)) return false;
  const size_t length = strlen(contents);
  const bool success = file.write(contents, length) == length;
  file.close();
  return success;
}

void normalizeText(std::string& value) {
  std::string normalized;
  normalized.reserve(value.size());
  bool pendingSpace = false;
  for (const unsigned char byte : value) {
    if (byte < 0x80 && std::isspace(byte)) {
      pendingSpace = !normalized.empty();
      continue;
    }
    if (byte < 0x20) continue;
    if (pendingSpace) normalized.push_back(' ');
    normalized.push_back(static_cast<char>(byte));
    pendingSpace = false;
  }
  value.swap(normalized);
}

std::string filenameTitle(const std::string& path) {
  const size_t slash = path.find_last_of('/');
  const size_t start = slash == std::string::npos ? 0 : slash + 1;
  const size_t dot = path.find_last_of('.');
  return path.substr(start, dot == std::string::npos || dot <= start ? std::string::npos : dot - start);
}

int hexValue(char value) {
  if (value >= '0' && value <= '9') return value - '0';
  if (value >= 'a' && value <= 'f') return value - 'a' + 10;
  if (value >= 'A' && value <= 'F') return value - 'A' + 10;
  return -1;
}

bool isTextToken(const char* token) { return token && (token[0] == '(' || (token[0] == '<' && token[1] != '<')); }

// Keep generated page names in FAT 8.3 form.  Besides saving directory space,
// this avoids long-file-name metadata churn while a large book is indexed.
std::string pageHref(size_t pageIndex) { return "text/p" + std::to_string(pageIndex) + ".htm"; }

bool endsWithSpace(const std::string& value) {
  return !value.empty() && std::isspace(static_cast<unsigned char>(value.back()));
}
}  // namespace

Pdf::Pdf(std::string path, std::string cacheBasePath) : filepath(std::move(path)), title(filenameTitle(filepath)) {
  const std::string key = std::to_string(std::hash<std::string>{}(filepath));
  cachePath = std::move(cacheBasePath) + "/epub_" + key;
  packagePath = cachePath + "/package";
}

Pdf::~Pdf() {
  closeDocument();
  removeTemporaryXref();
}

ssize_t Pdf::inputRead(void* context, void* data, size_t length) {
  pdf_runtime::serviceWatchdog();
  auto* input = static_cast<InputContext*>(context);
  if (!input || !input->file.isOpen()) return -1;
  return input->file.read(data, length);
}

off_t Pdf::inputSeek(void* context, off_t offset, int whence) {
  pdf_runtime::serviceWatchdog();
  auto* input = static_cast<InputContext*>(context);
  if (!input || !input->file.isOpen()) return -1;

  int64_t target = offset;
  if (whence == SEEK_CUR)
    target += static_cast<int64_t>(input->file.position());
  else if (whence == SEEK_END)
    target += static_cast<int64_t>(input->size);
  else if (whence != SEEK_SET)
    return -1;

  if (target < 0 || static_cast<uint64_t>(target) > input->size || !input->file.seek64(static_cast<uint64_t>(target)))
    return -1;
  return static_cast<off_t>(target);
}

void Pdf::inputClose(void* context) {
  auto* input = static_cast<InputContext*>(context);
  if (!input) return;
  if (input->file.isOpen()) input->file.close();
  if (input->xref.isOpen()) input->xref.close();
  delete input;
}

bool Pdf::xrefAccess(void* context, size_t number, pdfio_xref_t* record, bool writeRecord) {
  pdf_runtime::serviceWatchdog();
  auto* input = static_cast<InputContext*>(context);
  if (!input || !record || !input->xref.isOpen()) return false;
  const uint64_t position = static_cast<uint64_t>(number) * sizeof(pdfio_xref_t);
  if (!writeRecord) {
    memset(record, 0, sizeof(*record));
    if (position + sizeof(*record) > input->xrefSize || !input->xref.seek64(position)) return false;
    return input->xref.read(record, sizeof(*record)) == sizeof(*record);
  }

  // SdFat deliberately rejects seeking past EOF.  Extend the temporary xref
  // file sequentially before positioning at a potentially sparse object ID.
  if (position > input->xrefSize) {
    static const uint8_t zeros[64]{};
    if (!input->xref.seek64(input->xrefSize)) return false;
    while (input->xrefSize < position) {
      const size_t count = static_cast<size_t>(std::min<uint64_t>(sizeof(zeros), position - input->xrefSize));
      if (input->xref.write(zeros, count) != count) return false;
      input->xrefSize += count;
    }
  }
  if (!input->xref.seek64(position) || input->xref.write(record, sizeof(*record)) != sizeof(*record)) return false;
  input->xrefSize = std::max<uint64_t>(input->xrefSize, position + sizeof(*record));
  return true;
}

bool Pdf::pdfError(pdfio_file_t*, const char* message, void* context) {
  auto* self = static_cast<Pdf*>(context);
  if (self && message) self->lastError = message;
  LOG_ERR("PDF", "%s", message ? message : "Unknown PDF error");
  return message && strncmp(message, "WARNING:", 8) == 0;
}

bool Pdf::openDocument() {
  closeDocument();
  auto* input = new (std::nothrow) InputContext();
  if (!input) {
    lastError = "Not enough memory for PDF input";
    return false;
  }
  if (!Storage.openFileForRead("PDF", filepath, input->file)) {
    delete input;
    lastError = "Unable to open PDF from SD card";
    return false;
  }
  input->size = input->file.fileSize64();
  const std::string xrefPath = cachePath + "/.pdf_xref.bin";
  const int xrefFlags = xrefCacheReady ? (O_RDWR | O_CREAT) : (O_RDWR | O_CREAT | O_TRUNC);
  input->xref = Storage.open(xrefPath.c_str(), xrefFlags);
  if (!input->xref.isOpen()) {
    input->file.close();
    delete input;
    lastError = "Unable to create PDF index on SD card";
    return false;
  }
  input->xrefSize = input->xref.fileSize64();
  document = pdfioFileOpenIO(filepath.c_str(), inputRead, inputSeek, inputClose, xrefAccess, input, nullptr, nullptr,
                             pdfError, this);
  if (!document) {
    xrefCacheReady = false;
    Storage.remove(xrefPath.c_str());
    return false;
  }
  xrefCacheReady = true;
  return true;
}

void Pdf::closeDocument() {
  if (!document) return;
  pdfioFileClose(document);
  document = nullptr;
}

void Pdf::removeTemporaryXref() {
  xrefCacheReady = false;
  Storage.remove((cachePath + "/.pdf_xref.bin").c_str());
}

void Pdf::setupCacheDir() const { Storage.mkdir(cachePath.c_str(), true); }

bool Pdf::cacheIsCurrent() {
  if (!Storage.exists((packagePath + "/META-INF/container.xml").c_str()) ||
      !Storage.exists((packagePath + "/OEBPS/content.opf").c_str())) {
    return false;
  }
  HalFile state;
  if (!Storage.openFileForRead("PDF", cachePath + PACKAGE_STATE_FILE, state)) return false;
  uint8_t version = 0;
  uint64_t cachedSize = 0;
  uint64_t cachedFingerprint = 0;
  uint16_t cachedPages = 0;
  uint16_t cachedRasterWidth = 0;
  uint16_t cachedRasterHeight = 0;
  const bool valid = state.read(&version, sizeof(version)) == sizeof(version) &&
                     state.read(&cachedSize, sizeof(cachedSize)) == sizeof(cachedSize) &&
                     state.read(&cachedFingerprint, sizeof(cachedFingerprint)) == sizeof(cachedFingerprint) &&
                     state.read(&cachedPages, sizeof(cachedPages)) == sizeof(cachedPages) &&
                     state.read(&cachedRasterWidth, sizeof(cachedRasterWidth)) == sizeof(cachedRasterWidth) &&
                     state.read(&cachedRasterHeight, sizeof(cachedRasterHeight)) == sizeof(cachedRasterHeight) &&
                     version == PACKAGE_VERSION && cachedSize == sourceSize && cachedFingerprint == sourceFingerprint &&
                     cachedPages > 0 && cachedRasterWidth == rasterWidth && cachedRasterHeight == rasterHeight;
  state.close();
  if (valid) pageCount = cachedPages;
  return valid;
}

bool Pdf::loadMetadataCache() {
  char buffer[1536];
  const size_t length = Storage.readFileToBuffer((cachePath + METADATA_FILE).c_str(), buffer, sizeof(buffer));
  if (length == 0) return false;
  const char* first = strchr(buffer, '\n');
  if (!first) return false;
  const char* second = strchr(first + 1, '\n');
  if (!second) return false;
  title.assign(buffer, first - buffer);
  author.assign(first + 1, second - first - 1);
  language.assign(second + 1);
  while (!language.empty() && (language.back() == '\n' || language.back() == '\r')) language.pop_back();
  if (language.empty()) language = "und";
  return !title.empty();
}

void Pdf::saveMetadataCache() const {
  HalFile file;
  if (!Storage.openFileForWrite("PDF", cachePath + METADATA_FILE, file)) return;
  writeBytes(file, title);
  file.write(static_cast<uint8_t>('\n'));
  writeBytes(file, author);
  file.write(static_cast<uint8_t>('\n'));
  writeBytes(file, language);
  file.write(static_cast<uint8_t>('\n'));
  file.close();
}

void Pdf::saveCacheSignature() const {
  HalFile file;
  if (!Storage.openFileForWrite("PDF", cachePath + PACKAGE_STATE_FILE, file)) return;
  const uint8_t version = PACKAGE_VERSION;
  const uint16_t pages = static_cast<uint16_t>(std::min(pageCount, static_cast<size_t>(UINT16_MAX)));
  file.write(&version, sizeof(version));
  file.write(&sourceSize, sizeof(sourceSize));
  file.write(&sourceFingerprint, sizeof(sourceFingerprint));
  file.write(&pages, sizeof(pages));
  file.write(&rasterWidth, sizeof(rasterWidth));
  file.write(&rasterHeight, sizeof(rasterHeight));
  file.close();
}

void Pdf::postProcessMetadata() {
  normalizeText(title);
  normalizeText(author);
  normalizeText(language);
  if (title.empty()) title = filenameTitle(filepath);
  if (language.empty()) language = "und";
}

bool Pdf::load() {
  if (loaded) return true;
  packageBuiltDuringLoad = false;
  if (!Storage.exists(filepath.c_str())) {
    lastError = "PDF file does not exist";
    return false;
  }
  cache_integrity::SourceFingerprint fingerprint;
  if (!cache_integrity::fingerprintFile(filepath, fingerprint)) {
    lastError = "Unable to fingerprint PDF from SD card";
    return false;
  }
  sourceSize = fingerprint.size;
  sourceFingerprint = fingerprint.sampleHash;

  if (cacheIsCurrent() && loadMetadataCache()) {
    loaded = true;
    LOG_INF("PDF", "Loaded cached PDF package: %u pages", static_cast<unsigned>(pageCount));
    return true;
  }

  if (!convertToPackage()) return false;
  loaded = true;
  return true;
}

bool Pdf::convertToPackage() {
  // Cache creation is a bounded foreground operation, but large books and
  // recursive cleanup after an interrupted conversion can legitimately spend
  // more than the loop-task watchdog timeout inside SdFat/PDFio. Keep the
  // system watchdog active for every other task while temporarily removing
  // only this conversion task, then restore its subscription on every exit.
  pdf_runtime::ScopedWatchdogPause watchdogPause;
  xrefCacheReady = false;
  if (!pdfioPrepareFlateWorkspace()) {
    lastError = "Not enough memory for the PDF decoder";
    return false;
  }
  if (Storage.exists(cachePath.c_str()) && !Storage.removeDir(cachePath.c_str()) && Storage.exists(cachePath.c_str())) {
    // A reset during FAT metadata updates can leave a half-built cache whose
    // child directory can no longer be traversed.  Move that directory aside
    // at its healthy parent and build into a fresh canonical cache path.
    bool quarantined = false;
    for (unsigned attempt = 1; attempt <= 16; ++attempt) {
      const std::string stalePath = cachePath + ".stale" + std::to_string(attempt);
      if (Storage.exists(stalePath.c_str())) continue;
      if (Storage.rename(cachePath.c_str(), stalePath.c_str())) {
        quarantined = true;
        break;
      }
    }
    if (!quarantined) {
      pdfioReleaseFlateWorkspace();
      lastError = "Unable to replace an incomplete PDF cache";
      return false;
    }
  }
  setupCacheDir();
  if (!Storage.exists(cachePath.c_str()) || !Storage.mkdir((packagePath + "/META-INF").c_str(), true) ||
      !Storage.mkdir((packagePath + "/OEBPS/text").c_str(), true) ||
      !Storage.mkdir((packagePath + "/OEBPS/images").c_str(), true)) {
    pdfioReleaseFlateWorkspace();
    lastError = "Unable to create the PDF reader cache";
    return false;
  }

  const auto fail = [this]() {
    if (imageRecords.isOpen()) imageRecords.close();
    closeDocument();
    removeTemporaryXref();
    pdfioReleaseFlateWorkspace();
    if (Storage.exists(cachePath.c_str())) Storage.removeDir(cachePath.c_str());
    return false;
  };

  if (!openDocument()) return fail();
  pageCount = pdfioFileGetNumPages(document);
  if (pageCount == 0 || pageCount > MAX_PAGES) {
    lastError = pageCount == 0 ? "PDF has no pages" : "PDF has too many pages";
    return fail();
  }

  if (const char* value = pdfioFileGetTitle(document); value && *value) title = value;
  if (const char* value = pdfioFileGetAuthor(document); value && *value) author = value;
  if (const char* value = pdfioFileGetLanguage(document); value && *value) language = value;
  postProcessMetadata();

  imageCount = 0;
  if (!Storage.openFileForWrite("PDF", cachePath + IMAGE_RECORDS_FILE, imageRecords)) return fail();
  for (size_t pageIndex = 0; pageIndex < pageCount; ++pageIndex) {
    pdf_runtime::serviceWatchdog();
    // PDFio intentionally keeps loaded objects. Reopen for every page so the
    // dictionaries, resources and embedded fonts from a vector-heavy page are
    // released before the next page starts. The SD-backed xref is retained and
    // reused, avoiding a full cross-reference rebuild for every page.
    if (pageIndex > 0) {
      closeDocument();
      if (!openDocument()) return fail();
    }
    if (progressCallback) progressCallback(progressContext, pageIndex, pageCount);
    pdfio_obj_t* page = pdfioFileGetPage(document, pageIndex);
    if (!page) {
      lastError = "Unable to load PDF page " + std::to_string(pageIndex + 1);
      return fail();
    }
    std::vector<PageImage> pageImages;
    bool rasterized = false;
    if (PdfRasterizer::pageNeedsRasterization(page)) {
      const std::string filename = "page_" + std::to_string(pageIndex) + "_raster.png";
      PdfRasterizer rasterizer(rasterScratch, rasterScratchSize, rasterWidth, rasterHeight);
      std::string rasterError;
      if (rasterizer.renderPage(page, packagePath + "/OEBPS/images/" + filename, rasterError) &&
          recordImage(filename)) {
        pageImages.push_back({"", filename, true});
        rasterized = true;
      } else {
        // A number of fixed-layout/scanned PDFs use JPEG Image XObjects that
        // the compact vector rasterizer deliberately cannot paint. Preserve
        // those through the image/text extraction path below instead of
        // rejecting an otherwise readable document. Hard raster limits still
        // cannot publish a blank cache: writePage emits extracted content (or
        // an explicit unsupported-content notice) and all writes are checked.
        LOG_ERR("PDF", "Page %u raster path unavailable, using extraction fallback: %s",
                static_cast<unsigned>(pageIndex + 1),
                rasterError.empty() ? "unable to persist raster image" : rasterError.c_str());
        Storage.remove((packagePath + "/OEBPS/images/" + filename).c_str());
      }
    }
    if ((!rasterized && !extractPageImages(page, pageIndex, pageImages)) || !writePage(page, pageIndex, pageImages))
      return fail();
    pdf_runtime::serviceWatchdog();
  }
  if (progressCallback) progressCallback(progressContext, pageCount, pageCount);
  imageRecords.close();
  closeDocument();
  removeTemporaryXref();
  pdfioReleaseFlateWorkspace();

  if (!writeContainerFile() || !writeStyleFile() || !writeOpfFile() || !writeNcxFile()) {
    lastError = "Unable to write PDF reader cache";
    if (Storage.exists(cachePath.c_str())) Storage.removeDir(cachePath.c_str());
    return false;
  }
  saveMetadataCache();
  saveCacheSignature();
  packageBuiltDuringLoad = true;
  Storage.remove((cachePath + IMAGE_RECORDS_FILE).c_str());
  LOG_INF("PDF", "Built native PDF package: %u pages, %u JPEG images", static_cast<unsigned>(pageCount),
          static_cast<unsigned>(imageCount));
  return true;
}

pdfio_dict_t* Pdf::resolveDict(pdfio_dict_t* dict, const char* key) {
  if (!dict) return nullptr;
  if (pdfio_dict_t* direct = pdfioDictGetDict(dict, key)) return direct;
  if (pdfio_obj_t* object = pdfioDictGetObj(dict, key)) return pdfioObjGetDict(object);
  return nullptr;
}

pdfio_dict_t* Pdf::findInheritedDict(pdfio_obj_t* page, const char* key) {
  for (size_t depth = 0; page && depth < 32; ++depth) {
    pdfio_dict_t* dict = pdfioObjGetDict(page);
    if (!dict) return nullptr;
    if (pdfio_dict_t* value = resolveDict(dict, key)) return value;
    page = pdfioDictGetObj(dict, "Parent");
  }
  return nullptr;
}

pdfio_obj_t* Pdf::findFontObject(pdfio_obj_t* page, const std::string& resourceName) {
  pdfio_dict_t* resources = findInheritedDict(page, "Resources");
  pdfio_dict_t* fonts = resolveDict(resources, "Font");
  return fonts && !resourceName.empty() ? pdfioDictGetObj(fonts, resourceName.c_str()) : nullptr;
}

uint32_t Pdf::glyphNameToUnicode(const char* name) {
  if (!name || !*name) return 0;
  if (!name[1]) return static_cast<unsigned char>(name[0]);
  if (!strncmp(name, "uni", 3) && strlen(name) >= 7) return static_cast<uint32_t>(strtoul(name + 3, nullptr, 16));
  if (name[0] == 'u' && strlen(name) >= 5) return static_cast<uint32_t>(strtoul(name + 1, nullptr, 16));
  if (!strncmp(name, "afii", 4)) {
    const int value = atoi(name + 4);
    if (value >= 10017 && value <= 10049) {
      if (value == 10023) return 0x0401;
      return value < 10023 ? 0x0410 + value - 10017 : 0x0416 + value - 10024;
    }
    if (value >= 10065 && value <= 10097) {
      if (value == 10071) return 0x0451;
      return value < 10071 ? 0x0430 + value - 10065 : 0x0436 + value - 10072;
    }
    switch (value) {
      case 10050:
        return 0x0490;
      case 10098:
        return 0x0491;
      case 10147:
        return 0x0406;
      case 10195:
        return 0x0456;
      case 10148:
        return 0x0407;
      case 10196:
        return 0x0457;
      case 10101:
        return 0x0404;
      case 10102:
        return 0x0454;
      case 10055:
        return 0x0408;
      case 10103:
        return 0x0458;
      default:
        break;
    }
  }

  struct NameMap {
    const char* name;
    uint16_t codepoint;
  };
  static constexpr NameMap common[] = {
      {"space", 0x0020},        {"nbspace", 0x00a0},       {"nonbreakingspace", 0x00a0},
      {"comma", 0x002c},        {"period", 0x002e},        {"colon", 0x003a},
      {"semicolon", 0x003b},    {"hyphen", 0x002d},        {"endash", 0x2013},
      {"emdash", 0x2014},       {"minus", 0x2212},         {"quoteleft", 0x2018},
      {"quoteright", 0x2019},   {"quotedblleft", 0x201c},  {"quotedblright", 0x201d},
      {"quotesingle", 0x0027},  {"quotedbl", 0x0022},      {"ellipsis", 0x2026},
      {"bullet", 0x2022},       {"guillemotleft", 0x00ab}, {"guillemotright", 0x00bb},
      {"parenleft", 0x0028},    {"parenright", 0x0029},    {"bracketleft", 0x005b},
      {"bracketright", 0x005d}, {"slash", 0x002f},         {"backslash", 0x005c},
      {"question", 0x003f},     {"exclam", 0x0021},        {"numbersign", 0x0023},
      {"percent", 0x0025},      {"ampersand", 0x0026},     {"asterisk", 0x002a},
      {"plus", 0x002b},         {"equal", 0x003d},         {"underscore", 0x005f},
      {"at", 0x0040},           {"copyright", 0x00a9},     {"registered", 0x00ae},
      {"Euro", 0x20ac},         {"numero", 0x2116},        {"degree", 0x00b0},
      {"zero", 0x0030},         {"one", 0x0031},           {"two", 0x0032},
      {"three", 0x0033},        {"four", 0x0034},          {"five", 0x0035},
      {"six", 0x0036},          {"seven", 0x0037},         {"eight", 0x0038},
      {"nine", 0x0039}};
  for (const auto& item : common) {
    if (!strcmp(name, item.name)) return item.codepoint;
  }
  return 0;
}

void Pdf::addCMapEntry(FontDecoder& decoder, uint32_t source, uint8_t sourceBytes, const std::string& text) {
  if (!decoder.cmap || text.empty() || text.size() >= sizeof(CMapEntry::text) || sourceBytes == 0 || sourceBytes > 4 ||
      decoder.cmapSize >= decoder.cmapLimit)
    return;
  decoder.maxCodeBytes = std::max(decoder.maxCodeBytes, sourceBytes);
  CMapEntry& entry = decoder.cmap[decoder.cmapSize++];
  entry.key = (static_cast<uint64_t>(sourceBytes) << 32) | source;
  entry.textLength = static_cast<uint8_t>(text.size());
  memcpy(entry.text, text.data(), text.size());
}

bool Pdf::parseHexSource(const char* token, uint32_t& value, uint8_t& bytes) {
  value = 0;
  bytes = 0;
  if (!token || token[0] != '<' || token[1] == '<') return false;
  int high = -1;
  for (const char* ptr = token + 1; *ptr && *ptr != '>'; ++ptr) {
    const int digit = hexValue(*ptr);
    if (digit < 0) continue;
    if (high < 0)
      high = digit;
    else {
      if (bytes >= 4) return false;
      value = (value << 8) | static_cast<uint32_t>((high << 4) | digit);
      ++bytes;
      high = -1;
    }
  }
  if (high >= 0) {
    if (bytes >= 4) return false;
    value = (value << 8) | static_cast<uint32_t>(high << 4);
    ++bytes;
  }
  return bytes > 0;
}

std::string Pdf::decodeUtf16Hex(const char* token, uint32_t increment) {
  uint8_t data[32];
  size_t length = 0;
  int high = -1;
  if (!token || token[0] != '<') return {};
  for (const char* ptr = token + 1; *ptr && *ptr != '>' && length < sizeof(data); ++ptr) {
    const int digit = hexValue(*ptr);
    if (digit < 0) continue;
    if (high < 0)
      high = digit;
    else {
      data[length++] = static_cast<uint8_t>((high << 4) | digit);
      high = -1;
    }
  }
  if (high >= 0 && length < sizeof(data)) data[length++] = static_cast<uint8_t>(high << 4);
  if (length == 0) return {};

  std::vector<uint32_t> codepoints;
  size_t position = 0;
  if (length >= 2 && data[0] == 0xfe && data[1] == 0xff) position = 2;
  if ((length - position) >= 2) {
    while (position + 1 < length) {
      uint32_t codepoint = (static_cast<uint32_t>(data[position]) << 8) | data[position + 1];
      position += 2;
      if (codepoint >= 0xd800 && codepoint <= 0xdbff && position + 1 < length) {
        const uint32_t low = (static_cast<uint32_t>(data[position]) << 8) | data[position + 1];
        if (low >= 0xdc00 && low <= 0xdfff) {
          codepoint = 0x10000 + ((codepoint - 0xd800) << 10) + (low - 0xdc00);
          position += 2;
        }
      }
      codepoints.push_back(codepoint);
    }
  } else {
    codepoints.push_back(data[0]);
  }
  if (!codepoints.empty()) codepoints.back() += increment;
  std::string output;
  for (const uint32_t codepoint : codepoints) appendUtf8(output, codepoint);
  return output;
}

bool Pdf::loadToUnicode(pdfio_obj_t* font, FontDecoder& decoder) {
  pdfio_dict_t* fontDict = font ? pdfioObjGetDict(font) : nullptr;
  pdfio_obj_t* cmapObject = fontDict ? pdfioDictGetObj(fontDict, "ToUnicode") : nullptr;
  if (!cmapObject) return false;
  pdfio_stream_t* stream = pdfioObjOpenStream(cmapObject, true);
  if (!stream) return false;

  enum class Mode : uint8_t { None, BfChar, BfRange, BfRangeArray };
  Mode mode = Mode::None;
  char token[PDF_TOKEN_SIZE];
  std::string first;
  std::string second;
  uint32_t rangeStart = 0;
  uint32_t rangeEnd = 0;
  uint32_t arraySource = 0;
  uint8_t rangeBytes = 0;

  while (pdfioStreamGetToken(stream, token, sizeof(token)) && decoder.cmapSize < decoder.cmapLimit) {
    if (!strcmp(token, "beginbfchar")) {
      mode = Mode::BfChar;
      first.clear();
      continue;
    }
    if (!strcmp(token, "endbfchar") || !strcmp(token, "endbfrange")) {
      mode = Mode::None;
      first.clear();
      second.clear();
      continue;
    }
    if (!strcmp(token, "beginbfrange")) {
      mode = Mode::BfRange;
      first.clear();
      second.clear();
      continue;
    }
    if (mode == Mode::BfChar) {
      if (!isTextToken(token)) continue;
      if (first.empty()) {
        first = token;
      } else {
        uint32_t source = 0;
        uint8_t sourceBytes = 0;
        if (parseHexSource(first.c_str(), source, sourceBytes))
          addCMapEntry(decoder, source, sourceBytes, decodeUtf16Hex(token));
        first.clear();
      }
      continue;
    }
    if (mode == Mode::BfRangeArray) {
      if (!strcmp(token, "]")) {
        mode = Mode::BfRange;
        first.clear();
        second.clear();
      } else if (isTextToken(token) && arraySource <= rangeEnd) {
        addCMapEntry(decoder, arraySource++, rangeBytes, decodeUtf16Hex(token));
      }
      continue;
    }
    if (mode != Mode::BfRange) continue;
    if (first.empty()) {
      if (isTextToken(token)) first = token;
      continue;
    }
    if (second.empty()) {
      if (isTextToken(token)) second = token;
      continue;
    }
    if (!parseHexSource(first.c_str(), rangeStart, rangeBytes) ||
        !parseHexSource(second.c_str(), rangeEnd, rangeBytes) || rangeEnd < rangeStart) {
      first.clear();
      second.clear();
      continue;
    }
    if (!strcmp(token, "[")) {
      arraySource = rangeStart;
      mode = Mode::BfRangeArray;
      continue;
    }
    if (isTextToken(token)) {
      const uint32_t count = std::min<uint32_t>(rangeEnd - rangeStart + 1, decoder.cmapLimit - decoder.cmapSize);
      for (uint32_t index = 0; index < count; ++index)
        addCMapEntry(decoder, rangeStart + index, rangeBytes, decodeUtf16Hex(token, index));
    }
    first.clear();
    second.clear();
  }
  pdfioStreamClose(stream);
  CMapEntry* const begin = decoder.cmap.get();
  CMapEntry* const end = begin + decoder.cmapSize;
  std::sort(begin, end, [](const CMapEntry& a, const CMapEntry& b) { return a.key < b.key; });
  decoder.cmapSize = static_cast<size_t>(
      std::unique(begin, end, [](const CMapEntry& a, const CMapEntry& b) { return a.key == b.key; }) - begin);
  return decoder.cmapSize > 0;
}

bool Pdf::loadFontDecoder(pdfio_obj_t* page, const std::string& resourceName, FontDecoder& decoder) {
  static constexpr uint16_t winAnsi[32] = {0x20ac, 0,      0x201a, 0x0192, 0x201e, 0x2026, 0x2020, 0x2021,
                                           0x02c6, 0x2030, 0x0160, 0x2039, 0x0152, 0,      0x017d, 0,
                                           0,      0x2018, 0x2019, 0x201c, 0x201d, 0x2022, 0x2013, 0x2014,
                                           0x02dc, 0x2122, 0x0161, 0x203a, 0x0153, 0,      0x017e, 0x0178};
  for (size_t index = 0; index < 256; ++index) decoder.encoding[index] = index;
  for (size_t index = 0; index < 32; ++index) decoder.encoding[index + 128] = winAnsi[index];
  decoder.cmap.reset();
  decoder.cmapSize = 0;
  decoder.maxCodeBytes = 1;

  // Reserve before opening the Flate stream. PNGdec's embedded zlib needs a
  // contiguous 32 KiB window, and growing the vector while that window is
  // live can fail on the X4's fragmented heap even when total free RAM is OK.
  if (decoder.cmapLimit > 0) {
    decoder.cmap.reset(new (std::nothrow) CMapEntry[decoder.cmapLimit]);
    if (!decoder.cmap) decoder.cmapLimit = 0;
  }

  pdfio_obj_t* font = findFontObject(page, resourceName);
  pdfio_dict_t* fontDict = font ? pdfioObjGetDict(font) : nullptr;
  if (!fontDict) return false;
  if (decoder.cmapLimit > 0) loadToUnicode(font, decoder);

  pdfio_dict_t* encodingDict = resolveDict(fontDict, "Encoding");
  pdfio_array_t* differences = encodingDict ? pdfioDictGetArray(encodingDict, "Differences") : nullptr;
  if (!differences) return decoder.cmapSize > 0;
  size_t target = 0;
  const size_t count = pdfioArrayGetSize(differences);
  for (size_t index = 0; index < count; ++index) {
    if (pdfioArrayGetType(differences, index) == PDFIO_VALTYPE_NUMBER) {
      target = static_cast<size_t>(pdfioArrayGetNumber(differences, index));
    } else if (pdfioArrayGetType(differences, index) == PDFIO_VALTYPE_NAME) {
      if (target < 256) {
        const uint32_t codepoint = glyphNameToUnicode(pdfioArrayGetName(differences, index));
        if (codepoint) decoder.encoding[target] = codepoint;
      }
      ++target;
    }
  }
  return true;
}

std::string Pdf::decodeTextToken(const char* token, const FontDecoder& decoder) {
  uint8_t bytes[PDF_TOKEN_SIZE / 2];
  size_t length = 0;
  if (!token) return {};
  if (token[0] == '(') {
    const unsigned char* ptr = reinterpret_cast<const unsigned char*>(token + 1);
    while (*ptr && length < sizeof(bytes)) bytes[length++] = *ptr++;
  } else if (token[0] == '<') {
    int high = -1;
    for (const char* ptr = token + 1; *ptr && *ptr != '>' && length < sizeof(bytes); ++ptr) {
      const int digit = hexValue(*ptr);
      if (digit < 0) continue;
      if (high < 0)
        high = digit;
      else {
        bytes[length++] = static_cast<uint8_t>((high << 4) | digit);
        high = -1;
      }
    }
    if (high >= 0 && length < sizeof(bytes)) bytes[length++] = static_cast<uint8_t>(high << 4);
  }

  std::string output;
  size_t position = 0;
  while (position < length) {
    const CMapEntry* match = nullptr;
    size_t matchBytes = 0;
    if (decoder.cmapSize > 0) {
      const size_t maxBytes = std::min<size_t>(decoder.maxCodeBytes, length - position);
      for (size_t count = maxBytes; count > 0; --count) {
        uint32_t source = 0;
        for (size_t index = 0; index < count; ++index) source = (source << 8) | bytes[position + index];
        const uint64_t key = (static_cast<uint64_t>(count) << 32) | source;
        const CMapEntry* const begin = decoder.cmap.get();
        const CMapEntry* const end = begin + decoder.cmapSize;
        const CMapEntry* const found =
            std::lower_bound(begin, end, key, [](const CMapEntry& entry, uint64_t value) { return entry.key < value; });
        if (found != end && found->key == key) {
          match = found;
          matchBytes = count;
          break;
        }
      }
    }
    if (match) {
      output.append(match->text, match->textLength);
      position += matchBytes;
    } else {
      appendUtf8(output, decoder.encoding[bytes[position]]);
      ++position;
    }
  }
  return output;
}

bool Pdf::extractJpeg(pdfio_obj_t* imageObject, const std::string& outputPath) {
  pdfio_stream_t* stream = pdfioObjOpenStream(imageObject, false);
  if (!stream) return false;
  HalFile output;
  if (!Storage.openFileForWrite("PDF", outputPath, output)) {
    pdfioStreamClose(stream);
    return false;
  }
  uint8_t buffer[1024];
  bool success = true;
  ssize_t bytes = 0;
  while ((bytes = pdfioStreamRead(stream, buffer, sizeof(buffer))) > 0) {
    if (output.write(buffer, static_cast<size_t>(bytes)) != static_cast<size_t>(bytes)) {
      success = false;
      break;
    }
  }
  if (bytes < 0) success = false;
  output.close();
  pdfioStreamClose(stream);
  if (!success) Storage.remove(outputPath.c_str());
  return success;
}

bool Pdf::recordImage(const std::string& filename) {
  const uint16_t filenameLength = static_cast<uint16_t>(std::min(filename.size(), static_cast<size_t>(UINT16_MAX)));
  if (imageRecords.write(&filenameLength, sizeof(filenameLength)) != sizeof(filenameLength) ||
      imageRecords.write(filename.data(), filenameLength) != filenameLength) {
    return false;
  }
  ++imageCount;
  return true;
}

bool Pdf::extractPageImages(pdfio_obj_t* page, size_t pageIndex, std::vector<PageImage>& pageImages) {
  pdfio_dict_t* resources = findInheritedDict(page, "Resources");
  pdfio_dict_t* xobjects = resolveDict(resources, "XObject");
  if (!xobjects) return true;

  const size_t count = pdfioDictGetNumPairs(xobjects);
  for (size_t index = 0; index < count; ++index) {
    const char* key = pdfioDictGetKey(xobjects, index);
    pdfio_obj_t* object = key ? pdfioDictGetObj(xobjects, key) : nullptr;
    if (!object || !pdfioObjGetSubtype(object) || strcmp(pdfioObjGetSubtype(object), "Image")) continue;
    pdfio_dict_t* dict = pdfioObjGetDict(object);
    if (!dict) continue;
    const char* filter = pdfioDictGetName(dict, "Filter");
    if (!filter) {
      if (pdfio_array_t* filters = pdfioDictGetArray(dict, "Filter"); filters && pdfioArrayGetSize(filters) == 1)
        filter = pdfioArrayGetName(filters, 0);
    }
    if (!filter || strcmp(filter, "DCTDecode")) continue;

    const std::string filename = "page_" + std::to_string(pageIndex) + "_image_" + std::to_string(index) + ".jpg";
    if (!extractJpeg(object, packagePath + "/OEBPS/images/" + filename)) continue;
    if (!recordImage(filename)) {
      Storage.remove((packagePath + "/OEBPS/images/" + filename).c_str());
      return false;
    }
    pageImages.push_back({key, filename, false});
  }
  return true;
}

bool Pdf::writePage(pdfio_obj_t* page, size_t pageIndex, const std::vector<PageImage>& pageImages) {
  HalFile output;
  if (!Storage.openFileForWrite("PDF", packagePath + "/OEBPS/" + pageHref(pageIndex), output)) return false;
  writeBytes(output,
             "<?xml version=\"1.0\" encoding=\"UTF-8\"?>\n"
             "<html xmlns=\"http://www.w3.org/1999/xhtml\"><head><title>Page ");
  writeBytes(output, std::to_string(pageIndex + 1));
  writeBytes(output,
             "</title><link rel=\"stylesheet\" type=\"text/css\" href=\"../style.css\"/></head>"
             "<body><div class=\"pdf-page\">");
  for (const auto& image : pageImages) {
    if (!image.fullPage) continue;
    writeBytes(output, "<div class=\"pdf-image pdf-raster-page\"><img src=\"../images/");
    writeXmlEscaped(output, image.filename, true);
    writeBytes(output, "\" alt=\"PDF page ");
    writeBytes(output, std::to_string(pageIndex + 1));
    writeBytes(output, "\"/></div></div></body></html>\n");
    output.close();
    return true;
  }
  writeBytes(output, "<h2 class=\"pdf-page-number\">Page ");
  writeBytes(output, std::to_string(pageIndex + 1));
  writeBytes(output, "</h2>");

  // PDFio allows one active stream per document. Discover the fonts first,
  // close the content streams, and only then load their ToUnicode streams.
  // The second pass can therefore decode text without nested stream opens.
  std::vector<std::string> usedFontNames;
  char token[PDF_TOKEN_SIZE];
  const size_t streamCount = pdfioPageGetNumStreams(page);
  for (size_t streamIndex = 0; streamIndex < streamCount; ++streamIndex) {
    pdfio_stream_t* stream = pdfioPageOpenStream(page, streamIndex, true);
    if (!stream) continue;
    std::string scanName;
    while (pdfioStreamGetToken(stream, token, sizeof(token))) {
      if (token[0] == '/') {
        scanName.assign(token + 1);
      } else if (!strcmp(token, "Tf") && !scanName.empty() && usedFontNames.size() < 8 &&
                 std::find(usedFontNames.begin(), usedFontNames.end(), scanName) == usedFontNames.end()) {
        usedFontNames.push_back(scanName);
      }
    }
    pdfioStreamClose(stream);
  }

  struct NamedDecoder {
    std::string name;
    FontDecoder decoder;
  };
  std::vector<NamedDecoder> fontDecoders;
  fontDecoders.reserve(usedFontNames.size());
  size_t totalCMapEntries = 0;
  for (const auto& name : usedFontNames) {
    NamedDecoder named;
    named.name = name;
    named.decoder.cmapLimit = std::min(MAX_CMAP_ENTRIES, MAX_PAGE_CMAP_ENTRIES - totalCMapEntries);
    loadFontDecoder(page, name, named.decoder);
    totalCMapEntries += named.decoder.cmapSize;
    fontDecoders.push_back(std::move(named));
  }
  FontDecoder defaultDecoder;
  loadFontDecoder(page, "", defaultDecoder);
  const FontDecoder* activeDecoder = &defaultDecoder;
  std::string currentName;
  std::string paragraph;
  bool inText = false;
  bool inArray = false;
  bool wroteContent = false;
  double lastNumber = 0;

  const auto flushParagraph = [&]() {
    normalizeText(paragraph);
    if (!paragraph.empty()) {
      writeBytes(output, "<p>");
      writeXmlEscaped(output, paragraph);
      writeBytes(output, "</p>\n");
      wroteContent = true;
    }
    paragraph.clear();
  };
  const auto writeImage = [&](const std::string& name) {
    for (const auto& image : pageImages) {
      if (image.resourceName != name) continue;
      flushParagraph();
      writeBytes(output, "<div class=\"pdf-image\"><img src=\"../images/");
      writeXmlEscaped(output, image.filename, true);
      writeBytes(output, "\" alt=\"PDF page image\"/></div>\n");
      wroteContent = true;
      return;
    }
  };

  for (size_t streamIndex = 0; streamIndex < streamCount; ++streamIndex) {
    pdfio_stream_t* stream = pdfioPageOpenStream(page, streamIndex, true);
    if (!stream) continue;
    while (pdfioStreamGetToken(stream, token, sizeof(token))) {
      if (!strcmp(token, "BT")) {
        inText = true;
      } else if (!strcmp(token, "ET")) {
        flushParagraph();
        inText = false;
      } else if (!strcmp(token, "[")) {
        inArray = true;
      } else if (!strcmp(token, "]")) {
        inArray = false;
      } else if (token[0] == '/') {
        currentName.assign(token + 1);
      } else if (!strcmp(token, "Tf") && !currentName.empty()) {
        activeDecoder = &defaultDecoder;
        for (const auto& named : fontDecoders) {
          if (named.name == currentName) {
            activeDecoder = &named.decoder;
            break;
          }
        }
      } else if (!strcmp(token, "Do") && !currentName.empty()) {
        writeImage(currentName);
      } else if (inText && isTextToken(token)) {
        paragraph += decodeTextToken(token, *activeDecoder);
      } else if (inText && inArray && (std::isdigit(static_cast<unsigned char>(token[0])) || token[0] == '-')) {
        lastNumber = strtod(token, nullptr);
        if (std::fabs(lastNumber) > 120 && !paragraph.empty() && !endsWithSpace(paragraph)) paragraph.push_back(' ');
      } else if (inText && (!strcmp(token, "Td") || !strcmp(token, "TD") || !strcmp(token, "T*") ||
                            !strcmp(token, "Tm") || !strcmp(token, "'") || !strcmp(token, "\""))) {
        flushParagraph();
      }
    }
    pdfioStreamClose(stream);
    flushParagraph();
  }

  // Some generators place the page JPEG behind a Form XObject that this
  // lightweight reflow reader cannot position. Preserve any extracted image
  // even if no matching Do operator was encountered.
  if (!wroteContent && !pageImages.empty()) {
    for (const auto& image : pageImages) writeImage(image.resourceName);
  }
  if (!wroteContent) {
    writeBytes(output,
               "<p class=\"pdf-notice\">This page contains PDF graphics or an image encoding not supported by this "
               "device.</p>");
  }
  writeBytes(output, "</div></body></html>\n");
  output.close();
  return true;
}

bool Pdf::writeContainerFile() const {
  return writeStaticFile(packagePath + "/META-INF/container.xml",
                         "<?xml version=\"1.0\" encoding=\"UTF-8\"?>\n"
                         "<container version=\"1.0\" xmlns=\"urn:oasis:names:tc:opendocument:xmlns:container\">"
                         "<rootfiles><rootfile full-path=\"OEBPS/content.opf\" "
                         "media-type=\"application/oebps-package+xml\"/></rootfiles></container>\n");
}

bool Pdf::writeStyleFile() const {
  return writeStaticFile(
      packagePath + "/OEBPS/style.css",
      "body { text-align: justify; }\n"
      ".pdf-page-number { text-align: center; font-size: 0.8em; font-weight: normal; margin: 0 0 0.8em; }\n"
      ".pdf-page p { margin: 0.22em 0; }\n"
      ".pdf-image { text-align: center; margin: 0.4em 0; }\n"
      ".pdf-image img { display: block; margin: 0 auto; max-width: 100%; }\n"
      ".pdf-raster-page { margin: 0; }\n"
      ".pdf-notice { font-style: italic; text-align: left; }\n");
}

bool Pdf::writeOpfFile() const {
  HalFile file;
  if (!Storage.openFileForWrite("PDF", packagePath + "/OEBPS/content.opf", file)) return false;
  writeBytes(file,
             "<?xml version=\"1.0\" encoding=\"UTF-8\"?>\n"
             "<package xmlns=\"http://www.idpf.org/2007/opf\" version=\"2.0\" unique-identifier=\"bookid\">"
             "<metadata xmlns:dc=\"http://purl.org/dc/elements/1.1/\"><dc:title>");
  writeXmlEscaped(file, title);
  writeBytes(file, "</dc:title><dc:creator>");
  writeXmlEscaped(file, author);
  writeBytes(file, "</dc:creator><dc:language>");
  writeXmlEscaped(file, language);
  writeBytes(file, "</dc:language><dc:identifier id=\"bookid\">pdf-");
  writeBytes(file, std::to_string(std::hash<std::string>{}(filepath)));
  writeBytes(file, "</dc:identifier>");
  if (imageCount > 0) writeBytes(file, "<meta name=\"cover\" content=\"cover-image\"/>");
  writeBytes(file,
             "</metadata><manifest><item id=\"ncx\" href=\"toc.ncx\" media-type=\"application/x-dtbncx+xml\"/>"
             "<item id=\"style\" href=\"style.css\" media-type=\"text/css\"/>");
  for (size_t index = 0; index < pageCount; ++index) {
    pdf_runtime::serviceWatchdog();
    writeBytes(file, "<item id=\"page-" + std::to_string(index) + "\" href=\"" + pageHref(index) +
                         "\" media-type=\"application/xhtml+xml\"/>");
  }
  HalFile imageInput;
  if (imageCount > 0 && !Storage.openFileForRead("PDF", cachePath + IMAGE_RECORDS_FILE, imageInput)) {
    file.close();
    return false;
  }
  for (size_t index = 0; index < imageCount; ++index) {
    pdf_runtime::serviceWatchdog();
    uint16_t filenameLength = 0;
    if (imageInput.read(&filenameLength, sizeof(filenameLength)) != sizeof(filenameLength) || filenameLength == 0 ||
        filenameLength > 512) {
      if (imageInput.isOpen()) imageInput.close();
      file.close();
      return false;
    }
    std::string filename(filenameLength, '\0');
    if (imageInput.read(filename.data(), filenameLength) != filenameLength) {
      if (imageInput.isOpen()) imageInput.close();
      file.close();
      return false;
    }
    writeBytes(file, "<item id=\"");
    writeBytes(file, index == 0 ? "cover-image" : "image-" + std::to_string(index));
    writeBytes(file, "\" href=\"images/");
    writeXmlEscaped(file, filename, true);
    const bool png = filename.size() >= 4 && filename.compare(filename.size() - 4, 4, ".png") == 0;
    writeBytes(file, png ? "\" media-type=\"image/png\"/>" : "\" media-type=\"image/jpeg\"/>");
  }
  if (imageInput.isOpen()) imageInput.close();
  writeBytes(file, "</manifest><spine toc=\"ncx\">");
  for (size_t index = 0; index < pageCount; ++index) {
    pdf_runtime::serviceWatchdog();
    writeBytes(file, "<itemref idref=\"page-" + std::to_string(index) + "\"/>");
  }
  writeBytes(file, "</spine><guide><reference type=\"text\" title=\"Start\" href=\"" + pageHref(0) +
                       "\"/></guide></package>\n");
  file.close();
  return true;
}

bool Pdf::writeNcxFile() const {
  HalFile file;
  if (!Storage.openFileForWrite("PDF", packagePath + "/OEBPS/toc.ncx", file)) return false;
  writeBytes(file,
             "<?xml version=\"1.0\" encoding=\"UTF-8\"?>\n"
             "<ncx xmlns=\"http://www.daisy.org/z3986/2005/ncx/\" version=\"2005-1\">"
             "<head><meta name=\"dtb:uid\" content=\"pdf\"/></head><docTitle><text>");
  writeXmlEscaped(file, title);
  writeBytes(file, "</text></docTitle><navMap>\n");
  for (size_t index = 0; index < pageCount; ++index) {
    pdf_runtime::serviceWatchdog();
    writeBytes(file, "<navPoint id=\"page-" + std::to_string(index + 1) + "\" playOrder=\"" +
                         std::to_string(index + 1) + "\"><navLabel><text>Page " + std::to_string(index + 1) +
                         "</text></navLabel><content src=\"" + pageHref(index) + "\"/></navPoint>\n");
  }
  writeBytes(file, "</navMap></ncx>\n");
  file.close();
  return true;
}

bool Pdf::clearCache() const {
  if (!Storage.exists(cachePath.c_str())) return true;
  return Storage.removeDir(cachePath.c_str());
}
